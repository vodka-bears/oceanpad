## boards/arm/oceanpad/board.yml
```yaml
board:
  name: oceanpad
  vendor: custom
  full_name: OceanPad Controller
  socs:
    - name: nrf52832
```

## boards/oceanpad/Kconfig
```kconfig
# boards/arm/oceanpad/Kconfig

config BOARD_OCEANPAD
    bool "OceanPad Board"
    select SOC_NRF52832_QFAA
```
